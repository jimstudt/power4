## main/Kconfig.projbuild
```kconfig
menu "Power4"

    config POWER4_MAX_RELAYS
        int "Maximum supported relay outputs"
        default 8
        range 8 32
        help
            Fixed storage reserved for relay state and BLE characteristics.
            The active relay count and hardware mapping come from the
            board_config flash partition.

    config POWER4_POLICY_PERIOD_SECONDS
        int "Policy evaluation period, seconds"
        default 60
        range 1 3600
        help
            Period between policy evaluations. The operational default is one
            minute.

    config POWER4_POLICY_TASK_STACK_BYTES
        int "Policy task stack size, bytes"
        default 16384
        range 4096 65536
        help
            Stack allocated for the policy task. Lua creates and tears down an
            interpreter each cycle, so this is intentionally larger than the
            simple relay and console support tasks.

    config POWER4_POLICY_TASK_PRIORITY
        int "Policy task priority"
        default 4
        range 1 24
        help
            FreeRTOS priority for the policy task.

    config POWER4_MAX_BATTERIES
        int "Maximum tracked batteries"
        default 16
        range 1 64
        help
            Maximum number of named batteries kept in the in-memory battery
            observation table. When a new battery is observed and the table is
            full, the least recently seen battery is evicted.

    config POWER4_MAX_BANKS
        int "Maximum configured battery banks"
        default 4
        range 1 16
        help
            Maximum number of named battery banks stored in NVS. Keeping this
            small bounds the persistent configuration blob and the temporary
            memory needed to edit it.

    config POWER4_BATTERY_SCAN_PERIOD_SECONDS
        int "BLE battery scan period, seconds"
        default 60
        range 10 3600
        help
            Period between BLE scans for battery management systems.

    config POWER4_BATTERY_SCAN_DURATION_SECONDS
        int "BLE battery scan duration, seconds"
        default 10
        range 1 60
        help
            Duration of each BLE scan window for battery management systems.

endmenu
```

## sdkconfig.defaults
```kconfig
CONFIG_IDF_TARGET="esp32s3"
CONFIG_ESP_SYSTEM_EVENT_TASK_STACK_SIZE=4096
CONFIG_POWER4_MAX_RELAYS=8
CONFIG_POWER4_POLICY_PERIOD_SECONDS=60
CONFIG_POWER4_POLICY_TASK_STACK_BYTES=16384
CONFIG_POWER4_POLICY_TASK_PRIORITY=4
CONFIG_POWER4_MAX_BATTERIES=16
CONFIG_POWER4_MAX_BANKS=4
CONFIG_POWER4_BATTERY_SCAN_PERIOD_SECONDS=60
CONFIG_POWER4_BATTERY_SCAN_DURATION_SECONDS=10
CONFIG_PARTITION_TABLE_CUSTOM=y
CONFIG_PARTITION_TABLE_CUSTOM_FILENAME="partitions.csv"
CONFIG_PARTITION_TABLE_FILENAME="partitions.csv"
CONFIG_ESP_CONSOLE_USB_SERIAL_JTAG=y
CONFIG_ESP_CONSOLE_SECONDARY_NONE=y
CONFIG_ESP_CONSOLE_UART_DEFAULT=n
CONFIG_BT_ENABLED=y
CONFIG_BT_NIMBLE_ENABLED=y
CONFIG_BT_NIMBLE_PROX_SERVICE=n
CONFIG_BT_NIMBLE_ANS_SERVICE=n
CONFIG_BT_NIMBLE_CTS_SERVICE=n
CONFIG_BT_NIMBLE_HTP_SERVICE=n
CONFIG_BT_NIMBLE_IPSS_SERVICE=n
CONFIG_BT_NIMBLE_TPS_SERVICE=n
CONFIG_BT_NIMBLE_IAS_SERVICE=n
CONFIG_BT_NIMBLE_LLS_SERVICE=n
CONFIG_BT_NIMBLE_SPS_SERVICE=n
CONFIG_BT_NIMBLE_HR_SERVICE=n
CONFIG_BT_NIMBLE_BAS_SERVICE=n
CONFIG_BT_NIMBLE_DIS_SERVICE=n
CONFIG_BT_NIMBLE_SVC_GAP_DEVICE_NAME="power4"
CONFIG_BT_NIMBLE_LOG_LEVEL_WARNING=y
CONFIG_BT_NIMBLE_LOG_LEVEL=2
CONFIG_BT_CTRL_SCAN_DUPL_TYPE_DEVICE=n
CONFIG_BT_CTRL_SCAN_DUPL_TYPE_DATA_DEVICE=y
CONFIG_ESP_COEX_SW_COEXIST_ENABLE=y
# The Wi-Fi radio is used only for low-rate, one-frame-at-a-time ESP-NOW.
# Avoid the throughput-oriented defaults, which reserve substantial internal
# RAM that is also needed by the Lua policy interpreter.
CONFIG_ESP_WIFI_STATIC_RX_BUFFER_NUM=4
CONFIG_ESP_WIFI_DYNAMIC_RX_BUFFER_NUM=4
CONFIG_ESP_WIFI_DYNAMIC_TX_BUFFER_NUM=4
CONFIG_ESP_WIFI_RX_MGMT_BUF_NUM_DEF=2
CONFIG_ESP_WIFI_MGMT_SBUF_NUM=6
# CONFIG_ESP_WIFI_IRAM_OPT is not set
# CONFIG_ESP_WIFI_RX_IRAM_OPT is not set
# CONFIG_ESP_WIFI_AMPDU_TX_ENABLED is not set
# CONFIG_ESP_WIFI_AMPDU_RX_ENABLED is not set
# CONFIG_ESP_WIFI_NVS_ENABLED is not set
CONFIG_ESP_WIFI_ESPNOW_MAX_ENCRYPT_NUM=0
CONFIG_ESP_SYSTEM_PANIC_PRINT_REBOOT=y
CONFIG_FREERTOS_USE_TRACE_FACILITY=y
CONFIG_LOG_DEFAULT_LEVEL_INFO=y
# Task stacks sized to at least twice their observed high water usage.
CONFIG_ESP_MAIN_TASK_STACK_SIZE=6144
CONFIG_ESP_IPC_TASK_STACK_SIZE=2048
CONFIG_BT_NIMBLE_HOST_TASK_STACK_SIZE=6144
```
